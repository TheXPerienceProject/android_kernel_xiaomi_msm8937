/*
 * Copyright (c) 2015, The Linux Foundation. All rights reserved.
 * Copyright (C) 2018 The XPerience Project
 *
 * This program is free software; you can redistribute it and/or modify
 * it under the terms of the GNU General Public License version 2 and
 * only version 2 as published by the Free Software Foundation.
 *
 * This program is distributed in the hope that it will be useful,
 * but WITHOUT ANY WARRANTY; without even the implied warranty of
 * MERCHANTABILITY or FITNESS FOR A PARTICULAR PURPOSE.  See the
 * GNU General Public License for more details.
 */
#include "dsi-panel-hx8394f-boe-720p-video.dtsi"
#include "dsi-panel-nt35521s-ebbg-720p-video.dtsi"
#include "dsi-panel-ili9881c-tianma-720p-video.dtsi"
&soc {
	mdss_mdp: qcom,mdss_mdp@1a00000 {

	qcom,mdp-settings = <0x01190 0x00000000>,
						<0x0506c 0x00000000>,
						<0x1506c 0x00000000>,
						<0x1706c 0x00000000>,
						<0x2506c 0x00000000>;
				};

		qcom,ion-heap@21 {
			reg = <21>;
			qcom,ion-heap-type = "SYSTEM_CONTIG";
		};

	};